/ {
    bvd: battery-voltage {
        compatible = "zmk,battery-voltage-divider";
        io-channels = <&adc 2>; /* P0.04 / AIN2 */
        output-ohms = <470000>;
        full-ohms = <1470000>; /* 1M + 470k divider */
        label = "BATTERY_VOLTAGE";
    };
};
